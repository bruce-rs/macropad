#include <behaviors.dtsi>
#include <dt-bindings/zmk/keys.h>

/ {
    keymap {
        compatible = "zmk,keymap";

        default_layer {
            // Key 1 = copy, key 2 = paste (Cmd on macOS; use LC(C) / LC(V) for Windows/Linux).
            bindings = <
                &kp LG(C) &kp LG(V)
            >;
        };
    };
};
